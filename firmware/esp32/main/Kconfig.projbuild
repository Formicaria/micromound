## firmware/esp32/main/Kconfig.projbuild
```kconfig
menu "MicroMound controller"

    choice MM_LINK
        prompt "How the board reaches the controller"
        default MM_LINK_WIFI
        help
            Wi-Fi: the board speaks HTTPS to the controller itself (TLS, SNTP, the root bundle).
            Serial: the board frames the same exchanges over a UART to a Pi running
            `micromound --bridge` (PROTOCOL.md §12); no network stack, no TLS, and the clock comes from
            the bridge. The signed envelopes are identical either way.

        config MM_LINK_WIFI
            bool "Wi-Fi + HTTPS (the board talks to the controller directly)"
        config MM_LINK_SERIAL
            bool "Serial link to a bridge (a Pi relays; the board has no network)"
        config MM_LINK_PORTS
            bool "Port server (a Pi's kernel drives this board's pins over the link; no identity, no enrollment)"
    endchoice

    config MM_PORTS_WATCHDOG_S
        int "Port server: seconds without a request before every pin goes safe"
        depends on MM_LINK_PORTS
        default 5
        help
            The Pi keeps the link alive at a third of this; a Pi that goes quiet loses its outputs.

    config MM_SERIAL_UART
        int "Link UART number"
        depends on MM_LINK_SERIAL || MM_LINK_PORTS
        default 0
        help
            UART 0 is the USB-serial console on most dev boards: the bridge then runs on the same cable
            that flashes the board, and the console log is off (it would corrupt the frames).

    config MM_SERIAL_TX_GPIO
        int "Link UART TX GPIO (-1 = the UART's default pin)"
        depends on MM_LINK_SERIAL || MM_LINK_PORTS
        default -1

    config MM_SERIAL_RX_GPIO
        int "Link UART RX GPIO (-1 = the UART's default pin)"
        depends on MM_LINK_SERIAL || MM_LINK_PORTS
        default -1

    config MM_SERIAL_BAUD
        int "Link baud rate"
        depends on MM_LINK_SERIAL || MM_LINK_PORTS
        default 115200

    config MM_CONTROLLER_URL
        string "Controller base URL"
        depends on MM_LINK_WIFI
        default "https://anthill.local:8443/"
        help
            Where the mound enrolls and beats: <url>micromound/v0/enroll and <url>micromound/v0/sync
            (PROTOCOL.md §3, §7). Must end with '/'. HTTPS only; the certificate is verified against the
            root bundle, or against main/certs/controller_ca.pem when that file holds a PEM certificate.

    config MM_MOUND_ID
        string "Mound id (the manifest's)"
        default "mm-7f3a0000-0000-4000-8000-000000000001"
        help
            The mound this board is. Enrollment refuses a token minted for another mound.

    config MM_ENROLL_TOKEN
        string "One-time enrollment token (bench provisioning)"
        default ""
        help
            Written into NVS on first boot when no token and no controller key are stored, then burned
            by the first definite answer. A compiled-in token is for the bench; provision NVS directly
            for a fleet (see README).

    config MM_NTP_SERVER
        string "NTP server"
        depends on MM_LINK_WIFI
        default "pool.ntp.org"

    config MM_RELAY_GPIO
        int "Relay output GPIO (act.relay_1)"
        default 5

    config MM_RELAY_ACTIVE_HIGH
        bool "Relay is energized by a HIGH level"
        default y

    config MM_SWITCH_GPIO
        int "Limit-switch input GPIO (sense.valve_closed), -1 for none"
        default -1
        help
            A digital INPUT the Pi can read with micromound/link/ports/read_pin — a limit switch, an
            interlock contact, a float. This is what lets a mound confirm an actuation with something
            other than its own command, so a bench with a relay and no switch can never report a
            verified actuation. The line is pulled up here, which is the wiring of nearly every dry
            contact to ground; -1 offers no input at all. A pin may be an input or an output, never
            both, and one that will not read at bring-up is refused rather than reported as open.

    config MM_SWITCH_ACTIVE_HIGH
        bool "The switch reads HIGH when closed"
        default n
        depends on MM_SWITCH_GPIO >= 0

    config MM_PROBE_ADC_CHANNEL
        int "Probe ADC1 channel (sense.temp)"
        default 0
        help
            ADC unit 1; the channel-to-pin map is the target's (channel 0 is GPIO36 on the ESP32).

    config MM_PROBE_SCALE_MILLI
        int "Probe scale × 1000 (reading = volts × scale + offset)"
        default 100000
        help
            100000 = 100.0: a 10 mV/°C sensor read in volts gives degrees.

    config MM_PROBE_OFFSET_MILLI
        int "Probe offset × 1000"
        default -50000
        help
            -50000 = -50.0: the sensor's zero point.

    config MM_TICK_MS
        int "Service loop period (ms)"
        default 1000

    config MM_ALLOW_NVS_ERASE
        bool "Development: erase NVS automatically when it will not initialise"
        default n
        help
            Leave this off. NVS holds the Ed25519 seed this mound's identity IS, the controller's
            public key, and the sticky stop a restart must never clear. With it off, a board whose
            NVS is full or was written by a newer IDF halts with every output at its safe level and
            says so, and reprovisioning is a deliberate act (`idf.py erase-flash`). With it on, the
            stock ESP-IDF recipe applies instead: the partition is erased and the board comes back as
            a different, unenrolled, un-stopped device. Only ever for a development board.

endmenu
```
